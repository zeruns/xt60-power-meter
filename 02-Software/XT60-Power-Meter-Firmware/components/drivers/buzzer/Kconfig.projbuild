## 02-Software/XT60-Power-Meter-Firmware/components/drivers/status_led/Kconfig.projbuild
```kconfig
# 系统状态指示灯的可调参数
#
# 查看 / 修改方式：
#   idf.py menuconfig → 组件配置 → 系统状态指示灯（SYS_LED）
# 保存后直接 idf.py build 即生效（menuconfig 会写入 sdkconfig）。
#
# 注意：本文件里的 default 只在"生成全新 sdkconfig"时起作用。
#       若 sdkconfig 已存在，改这里的 default 不会影响已有配置，
#       必须删除 sdkconfig 重新生成才会采用新的 default。
#
# 驱动代码（status_led.c）直接使用 CONFIG_STATUS_LED_* 宏，不再设本地默认值，
# 因此改动只有一个入口，不会出现"改了源码里的值却没效果"的情况。
#
# 四种闪烁模式的语义（与系统状态对应）：
#   常亮        ← 初始化中（INIT）
#   慢闪 1Hz    ← 正常运行（RUNNING）
#   快闪 5Hz    ← 异常（FAULT）
#   双闪+长灭   ← 降级运行（DEGRADED）

menu "系统状态指示灯（SYS_LED）"

    config STATUS_LED_SOLID_HOLD_MS
        int "常亮模式的刷新周期（毫秒）"
        range 100 5000
        default 1000
        help
            指示灯在"常亮"模式下每隔这么久重新点亮一次。
            视觉上就是一直亮着，调这个值没有实际观感差异，
            保留可配置只是为了与"步进式闪烁"的实现保持一致。

    config STATUS_LED_SLOW_ON_MS
        int "慢闪：点亮时长（毫秒）"
        range 50 5000
        default 500
        help
            正常运行状态下的闪烁节奏。默认 500ms 亮 + 500ms 灭 = 1Hz。

    config STATUS_LED_SLOW_OFF_MS
        int "慢闪：熄灭时长（毫秒）"
        range 50 5000
        default 500

    config STATUS_LED_FAST_ON_MS
        int "快闪：点亮时长（毫秒）"
        range 20 1000
        default 100
        help
            异常状态下的闪烁节奏。默认 100ms 亮 + 100ms 灭 = 5Hz，
            与慢闪有明显区分，便于现场一眼判断故障。

    config STATUS_LED_FAST_OFF_MS
        int "快闪：熄灭时长（毫秒）"
        range 20 1000
        default 100

    config STATUS_LED_DEGRADED_ON_MS
        int "降级双闪：单次点亮时长（毫秒）"
        range 20 1000
        default 120
        help
            降级运行（部分功能失效但仍可测量）时的提示节奏：
            连续两次短闪，然后一段长静默，以此与慢闪/快闪区分。

    config STATUS_LED_DEGRADED_OFF_MS
        int "降级双闪：两次短闪之间的熄灭时长（毫秒）"
        range 20 1000
        default 120

    config STATUS_LED_DEGRADED_GAP_MS
        int "降级双闪：周期末长静默时长（毫秒）"
        range 100 5000
        default 820
        help
            这段较长的静默是"降级"与"慢闪"的关键视觉差异，不宜设得太短。

endmenu
```

## 02-Software/XT60-Power-Meter-Firmware/main/Kconfig.projbuild
```kconfig
# XT60 功率计应用层可调参数
#
# 查看 / 修改方式：
#   idf.py menuconfig → 组件配置 → XT60 功率计应用配置
# 保存后直接 idf.py build 即生效（menuconfig 会写入 sdkconfig）。
#
# 注意：本文件里的 default 只在"生成全新 sdkconfig"时起作用。
#       若 sdkconfig 已存在，改这里的 default 不会影响已有配置，
#       必须删除 sdkconfig 重新生成才会采用新的 default。
#
# app_tasks.c 直接使用 CONFIG_APP_SYS_MONITOR_* 宏，不再设本地默认值。

menu "XT60 功率计应用配置"

    config APP_SYS_MONITOR_PERIOD_MS
        int "系统巡检输出周期（毫秒）"
        range 500 60000
        default 5000
        help
            巡检任务每隔这么久打印一次系统状态、内存水位与测量数据计数。
            联调阶段可以调小（如 1000）以观察得更细致；
            正式发布时可以调大或关闭该任务以减少日志量。

    config APP_SYS_MONITOR_STACK
        int "系统巡检任务栈大小（字节）"
        range 2048 16384
        default 4096
        help
            注意单位是「字节」而不是 FreeRTOS 文档常说的「字」
            （ESP-IDF 的 StackType_t 是 uint8_t，栈相关参数统一按字节计）。

            这个任务里会用到 snprintf 与日志格式化，栈需求比一般任务大。
            实测：栈设为 3072 字节时，高水位显示仅剩余 824 字节（约 27%），
            偏紧；因此默认值提高到 4096 字节，留出更安全的余量。
            运行时可在日志里查看"巡检任务栈：剩余 X 字节 / 共 Y 字节"，
            若剩余不足 25% 就继续调大。

    config APP_SYS_MONITOR_PRIO
        int "系统巡检任务优先级"
        range 1 10
        default 3
        help
            必须低于所有业务任务。它是观察者，绝不能抢占业务任务。

endmenu
```
